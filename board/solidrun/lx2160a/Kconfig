## board/solidrun/lx2160a/Kconfig
```kconfig
if TARGET_LX2160ACEX7

config SYS_BOARD
	default "lx2160a"

config SYS_VENDOR
	default "solidrun"

config SYS_SOC
	default "fsl-layerscape"

config SYS_CONFIG_NAME
	default "lx2160acex7"

config EMC2301
	bool "Fan controller"
	help
	 Enable the EMC2301 fan controller for configuration of fan
	 speed.

source "board/freescale/common/Kconfig"
endif
```
